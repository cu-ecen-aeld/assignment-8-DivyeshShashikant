## base_external/package/aesdchar/Config.in
```kconfig
config BR2_PACKAGE_AESDCHAR
	bool "aesdchar"
	help
	  Custom ldd package to be added for assignment 8
	  supports building and installing the aesdchar device in the rootfs
	  
```

## base_external/package/ldd/Config.in
```kconfig
config BR2_PACKAGE_LDD
	bool "ldd"
	help
	  Custom ldd package to be added for assignment 7 part 2
	  supports building and installing the misc-modules and scull components in the rootfs
	  
```
